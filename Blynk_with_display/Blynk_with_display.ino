/* Comment this out to disable prints and save space */
// 'buet', 128x64px
const unsigned char epd_bitmap_buet [] PROGMEM = {
	0x00, 0x00, 0x00, 0x00, 0x00, 0x00, 0x00, 0x21, 0x84, 0x00, 0x00, 0x00, 0x00, 0x00, 0x00, 0x00, 
	0x00, 0x00, 0x00, 0x00, 0x00, 0x00, 0x00, 0x31, 0x8e, 0x00, 0x00, 0x00, 0x00, 0x00, 0x00, 0x00, 
	0x00, 0x00, 0x00, 0x00, 0x00, 0x00, 0x0e, 0x31, 0xce, 0x30, 0x00, 0x00, 0x00, 0x00, 0x00, 0x00, 
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	0x00, 0x00, 0x00, 0x00, 0x00, 0x00, 0x00, 0x21, 0x84, 0x00, 0x00, 0x00, 0x00, 0x00, 0x00, 0x00
};



#define BLYNK_PRINT Serial


/* Fill in information from Blynk Device Info here */
#define BLYNK_TEMPLATE_ID "TMPL6XQEhFNX_"
#define BLYNK_TEMPLATE_NAME "Quickstart Template"
#define BLYNK_AUTH_TOKEN "zy2ZzEFdIDbQ4atDtn0FYBc6rWNPx0fz"


#define FAN 15
#define BULB 4
#define Mist 19
#define Light 23
#include <ESP32Servo.h>
#include <SPI.h>
#include <Wire.h>
#include <Adafruit_GFX.h>
#include <Adafruit_SSD1306.h>
#include "DHT.h"
#include <WiFi.h>
#include <BlynkSimpleEsp32.h>
#include "time.h"


Servo myservo;
int pos = 0;  

#if defined(CONFIG_IDF_TARGET_ESP32S2) || defined(CONFIG_IDF_TARGET_ESP32S3)
int servoPin = 17;
#elif defined(CONFIG_IDF_TARGET_ESP32C3)
int servoPin = 7;
#else
int servoPin = 18;
#endif

// Your WiFi credentials.
// Set password to "" for open networks.
char ssid[] = "POCOX2";
char pass[] = "12345678Y";

int interval = 1000;
int currentMillis;
int previousMillis = 0;

#define DHT11PIN 5
#define OLED_RESET 12
Adafruit_SSD1306 display(OLED_RESET);
DHT dht(DHT11PIN, DHT11);


BLYNK_WRITE(V0)
{
  int value = param.asInt();
  Serial.println(value);
  if(value == 1)
  {
    digitalWrite(Light, LOW);
    Serial.println("Light ON");
  }
  if(value == 0)
  {
     digitalWrite(Light, HIGH);
     Serial.println("Light OFF");
  }
}

BLYNK_WRITE(V7)
{
  int value = param.asInt();
  if(value!=pos){
    Serial.println(value);
    myservo.write(value);
    pos = value;
  }

}

BLYNK_WRITE(V1)
{
  int value = param.asInt();
  Serial.println(value);
  if(value == 1)
  {
    digitalWrite(FAN, LOW);
    Serial.println("FAN ON");
  }
  if(value == 0)
  {
     digitalWrite(FAN, HIGH);
     Serial.println("FAN OFF");
  }
}

BLYNK_WRITE(V3)
{
  int value = param.asInt();
  Serial.println(value);
  if(value == 1)
  {
    digitalWrite(Mist, LOW);
    Serial.println("Mist ON");
  }
  if(value == 0)
  {
     digitalWrite(Mist, HIGH);
     Serial.println("Mist OFF");
  }
}

BLYNK_WRITE(V4)
{
  int value = param.asInt();
  Serial.println(value);
  if(value == 1)
  {
    digitalWrite(BULB, LOW);
    Serial.println("BULB ON");
  }
  if(value == 0)
  {
     digitalWrite(BULB, HIGH);
     Serial.println("BULB OFF");
  }
}



void setup()
{
  
  pinMode(FAN,OUTPUT);
  pinMode(Mist,OUTPUT);
  pinMode(BULB,OUTPUT);
  pinMode(Light,OUTPUT);
  digitalWrite(FAN,HIGH);
  digitalWrite(BULB,HIGH);
  digitalWrite(Mist,HIGH);
  digitalWrite(Light, HIGH);
  display.begin(SSD1306_SWITCHCAPVCC, 0x3C);
  display.clearDisplay();
  display.drawBitmap(0, 0, epd_bitmap_buet, 128, 64, WHITE);
  display.display();
  delay(3000);
  
  ESP32PWM::allocateTimer(0);
	ESP32PWM::allocateTimer(1);
	ESP32PWM::allocateTimer(2);
	ESP32PWM::allocateTimer(3);
	myservo.setPeriodHertz(50);    // standard 50 hz servo
	myservo.attach(servoPin, 1000, 2000);
  // Debug console  
  Serial.begin(9600);
  Blynk.begin(BLYNK_AUTH_TOKEN, ssid, pass);
  
  /* Start the DHT11 Sensor */
  dht.begin();
  display.clearDisplay();
  display.setTextSize(2);
  display.setTextColor(WHITE);
  display.setCursor(2,5);
  display.println(" SMART EGG HATCHING  SYSTEM !!");
  display.display();
  delay(3000);

  
}

void loop()
{
  Blynk.run();
  currentMillis = millis();
  if (currentMillis - previousMillis >= interval) {                    // Check is ready a timer
        
        // Do something ...
      float humi = dht.readHumidity();
      float temp = dht.readTemperature();
      Blynk.virtualWrite(V5, temp);
      Blynk.virtualWrite(V6, humi);
      Serial.print("Temperature: ");
      Serial.print(temp);
      Serial.print("ºC ");
      Serial.print("Humidity: ");
      Serial.println(humi);
      display.clearDisplay();
      display.setTextSize(2);
      display.setTextColor(WHITE);
      display.setCursor(2,4);
      display.print("T: ");
      display.print(temp);
      display.print((char)247);
      display.print("C");
      display.print("\nH: ");
      display.print(humi);
      display.print(" %");
      display.print("\n");
      int tim = currentMillis/1000;
      if(tim<60){
        display.print("   ");
        display.print(tim);
        display.print(" s");
        display.display();
      }
      else{
        int min = tim/60;
        tim = tim % 60;
        display.print(min);
        display.print(" m:");
        display.print(tim);
        display.print(" s");
        display.display();
      }
      

      previousMillis = currentMillis;                      // Reset timer
    }
}
